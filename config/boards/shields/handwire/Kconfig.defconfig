## config/boards/shields/handwire/Kconfig.defconfig
```kconfig
if SHIELD_HANDWIRE_LEFT

config ZMK_KEYBOARD_NAME
    default "handwire"

config ZMK_SPLIT_ROLE_CENTRAL
    default y

endif

if SHIELD_HANDWIRE_LEFT || SHIELD_HANDWIRE_RIGHT

config ZMK_SPLIT
    default y

endif


# Set sleep timeout to 30min (30*60*1000ms)
CONFIG_ZMK_SLEEP=y
CONFIG_ZMK_IDLE_SLEEP_TIMEOUT=1800000

# Enable mouse
CONFIG_ZMK_MOUSE=y

CONFIG_ZMK_BEHAVIOR_HOLD_TAP=y
CONFIG_ZMK_BEHAVIOR_TAP_DANCE=y
CONFIG_ZMK_BEHAVIOR_MOD_MORPH=y

# Combo config, automated by build script
CONFIG_ZMK_COMBO_MAX_COMBOS_PER_KEY=6
CONFIG_ZMK_COMBO_MAX_KEYS_PER_COMBO=3

# Leader config, automated by build script
CONFIG_ZMK_LEADER_MAX_SEQUENCES_PER_KEY=27
CONFIG_ZMK_LEADER_MAX_KEYS_PER_SEQUENCE=2

# Bluetooth tweaks
CONFIG_ZMK_BLE_EXPERIMENTAL_CONN=y
CONFIG_BT_CTLR_TX_PWR_PLUS_8=y
# CONFIG_CLOCK_CONTROL_NRF_K32SRC_RC=y

# Enable 32kHz crystal
CONFIG_CLOCK_CONTROL_NRF_K32SRC_XTAL=y
CONFIG_CLOCK_CONTROL_NRF_K32SRC_30PPM=y

CONFIG_ZMK_USB=n
CONFIG_ZMK_BLE=y
```

## config/boards/shields/handwire/Kconfig.shield
```kconfig
config SHIELD_HANDWIRE_LEFT
    def_bool $(shields_list_contains, handwire_left)

config SHIELD_HANDWIRE_RIGHT
    def_bool $(shields_list_contains, handwire_right)
```
